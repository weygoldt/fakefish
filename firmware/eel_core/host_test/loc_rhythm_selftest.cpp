// Host self-test for the fitted resting-rhythm model (no Arduino).
// Compile + run on a PC:  g++ -std=c++17 -I.. loc_rhythm_selftest.cpp -lm -o t && ./t
//
// THIS IS A PARITY TEST, not a plausibility test. The C in ../loc_rhythm.h is a port of
// src/fakefish/loc_model.py, and the failure mode that matters is the two drifting apart —
// which is exactly what happened to the spec's own §7 C listing, whose tau_fast, hazard
// intercept and mixture widths all disagree with the fitted parameters it ships beside.
//
// So the oracle is not "does this look like a fish". It is tests/data/loc_rhythm_golden.csv,
// generated by the REFERENCE implementation with its noise draws injected rather than drawn:
// every row carries the four noise values one interval consumes and the state the reference
// reached. This binary replays the identical sequence through loc_rhythm_step() and requires
// the state, the score and the interval to agree. Nothing about the model can then move on one
// side alone — tests/test_loc_model.py holds the golden to the Python, check.sh holds this to
// the golden.
//
// The remaining checks cover what a golden cannot: the branches it deliberately does not
// encode (the cold-start step, the refractory clamp), and the statistical properties the whole
// exercise exists for, measured through the device's own PRNG rather than numpy's.
#include <cstdio>
#include <cstdlib>
#include <cstring>
#include <cmath>
#include <vector>
#include <algorithm>

#include "../loc_rhythm.h"

static int g_fail = 0;
#define CHECK(cond, msg) do { if (!(cond)) { printf("FAIL: %s\n", msg); g_fail++; } } while (0)

// float32 against a float64 oracle, over 50 recursive steps. The recurrence is contractive
// (a < 1), so the tolerance covers accumulated rounding and nothing else: a genuinely wrong
// constant, a dropped gain or a missing time dilation moves these by whole percent.
static const double TOL_STATE = 3e-5;   // absolute, on x[] and m (score units, O(1))
static const double TOL_IPI   = 3e-5;   // relative, on the interval

static int g_checked = 0;

// Free-running: feed each interval back as the next elapsed time. That is exactly what an
// uninterrupted localization train does — the device measures the same quantity off its
// sample clock instead, which only differs when something interrupts the train.
static float run_free(LocRhythm* r, float* dt) {
  float ipi = loc_rhythm_next_s(r, *dt);
  *dt = ipi;
  return ipi;
}

static void close_to(double got, double want, double tol, bool relative, const char* what,
                     int block, int step) {
  double err = fabs(got - want);
  if (relative) err /= fabs(want) > 1e-12 ? fabs(want) : 1.0;
  g_checked++;
  if (err > tol) {
    printf("FAIL: block %d step %d %s: got %.10g want %.10g (err %.3g)\n",
           block, step, what, got, want, err);
    g_fail++;
  }
}

// ===== the golden ======================================================================

struct Row {
  int   block, step;
  float rate, randomness, offset, dt0;
  double tempo;
  double n[LOC_N_COMPONENTS + 1];
  double x[LOC_N_COMPONENTS], m, ipi;
};

static bool read_golden(const char* path, std::vector<Row>& out) {
  FILE* f = fopen(path, "r");
  if (!f) return false;
  char line[1024];
  while (fgets(line, sizeof line, f)) {
    if (line[0] == '#' || line[0] == 'b') continue;   // comment or the column header
    Row r;
    double rate, randomness, offset, dt0;
    // block,rate,randomness,tempo,offset,dt0,step,n0..n3,x0..x2,m,ipi_s
    int got = sscanf(line, "%d,%lf,%lf,%lf,%lf,%lf,%d,%lf,%lf,%lf,%lf,%lf,%lf,%lf,%lf,%lf",
                     &r.block, &rate, &randomness, &r.tempo, &offset, &dt0, &r.step,
                     &r.n[0], &r.n[1], &r.n[2], &r.n[3],
                     &r.x[0], &r.x[1], &r.x[2], &r.m, &r.ipi);
    if (got != 16) { fclose(f); return false; }
    r.rate = (float)rate; r.randomness = (float)randomness;
    r.offset = (float)offset; r.dt0 = (float)dt0;
    out.push_back(r);
  }
  fclose(f);
  return !out.empty();
}

static void test_golden(const char* path) {
  std::vector<Row> rows;
  if (!read_golden(path, rows)) {
    printf("FAIL: cannot read the golden oracle at %s\n", path);
    printf("      regenerate with: uv run python tests/test_loc_model.py --emit\n");
    g_fail++;
    return;
  }

  LocRhythm r;
  int block = -1;
  for (const Row& row : rows) {
    if (row.block != block) {          // a new block == a new knob setting + fresh state
      block = row.block;
      memset(&r, 0, sizeof r);
      r.rng = 1;                       // unused: the golden injects every noise draw
      loc_rhythm_set_knobs(&r, row.rate, row.randomness);
      // The knob mapping is itself part of the port: the gain table lookup and the
      // rate/gain division must land where the reference put them, or every interval in
      // the block is scaled wrong in a way the state comparison alone would not localise.
      close_to(r.tempo, row.tempo, 1e-6, true, "tempo (gain table)", block, -1);
      r.offset     = row.offset;
      r.pending_dt = row.dt0;
      const float x0[LOC_N_COMPONENTS] = { 0.3f, -0.2f, 0.05f };
      for (int i = 0; i < LOC_N_COMPONENTS; i++) r.x[i] = x0[i];
      r.m = r.offset + x0[0] + x0[1] + x0[2];
    }
    float n[LOC_N_COMPONENTS + 1];
    for (int i = 0; i <= LOC_N_COMPONENTS; i++) n[i] = (float)row.n[i];
    double ipi = loc_rhythm_step(&r, n);
    for (int i = 0; i < LOC_N_COMPONENTS; i++)
      close_to(r.x[i], row.x[i], TOL_STATE, false, i == 0 ? "x_fast" : (i == 1 ? "x_medium" : "x_slow"),
               block, row.step);
    close_to(r.m, row.m, TOL_STATE, false, "score m", block, row.step);
    close_to(ipi, row.ipi, TOL_IPI, true, "interval", block, row.step);
  }
  // Nothing is printed on success: check.sh requires the binary's whole output to be "OK".
  if (rows.size() < 100u) { printf("FAIL: golden has only %d rows\n", (int)rows.size()); g_fail++; }
  if (g_checked < 1000)   { printf("FAIL: golden checked only %d values\n", g_checked); g_fail++; }
}

// ===== the branches the golden does not encode =========================================

// The very first draw of a power-on, where no time has passed yet. The reference leaves the
// components untouched there (it draws their noise inside the `if dt > 0` branch), so a C port
// that aged them by dt == 0 would still "work" — a == 1, so x survives — but would inject a
// whole extra noise term with sqrt(1 - a*a) == 0 scaling. Worth pinning: it is the one place
// the two implementations consume a different number of draws.
static void test_cold_start() {
  LocRhythm r;
  memset(&r, 0, sizeof r);
  r.rng = 12345;
  loc_rhythm_set_knobs(&r, 1.0f, 1.0f);
  r.offset = 0.0f;
  r.x[0] = 0.4f; r.x[1] = -0.1f; r.x[2] = 0.2f;
  r.pending_dt = 0.0f;
  const float n[LOC_N_COMPONENTS + 1] = { 9.0f, -9.0f, 9.0f, 0.0f };
  loc_rhythm_step(&r, n);
  CHECK(r.x[0] == 0.4f && r.x[1] == -0.1f && r.x[2] == 0.2f,
        "cold start (dt == 0) must leave the components untouched");
  CHECK(fabsf(r.m - 0.5f) < 1e-6f, "cold-start score is offset + sum(x)");
}

// A fresh device must come up warmed to its running distribution. A cold state starts
// noticeably SLOW (the components' stationary distribution is continuous-time while the model
// is observed at its own pulse times), so loc_rhythm_init burns LOC_BURN_IN intervals in.
static void test_init_burns_in_and_seeds() {
  LocRhythm a, b;
  loc_rhythm_init(&a, 1u, 1.0f, 1.0f);
  loc_rhythm_init(&b, 2u, 1.0f, 1.0f);
  CHECK(a.pending_dt > 0.0f, "init leaves a live interval pending");
  CHECK(a.offset != b.offset, "different seeds must give different fish");
  CHECK(a.rng != 0, "xorshift32 is absorbing at zero");

  LocRhythm z;
  loc_rhythm_init(&z, 0u, 1.0f, 1.0f);     // a zero seed must not wedge the generator
  float dz = z.pending_dt;
  double first = run_free(&z, &dz), second = run_free(&z, &dz);
  CHECK(first > 0.0 && second > 0.0 && first != second, "zero seed must still generate");

  // Same seed, same fish: the device must be reproducible on the bench.
  LocRhythm c, d;
  loc_rhythm_init(&c, 99u, 1.0f, 1.0f);
  loc_rhythm_init(&d, 99u, 1.0f, 1.0f);
  float dc = c.pending_dt, dd = d.pending_dt;
  CHECK(run_free(&c, &dc) == run_free(&d, &dd), "one seed must give one sequence");
}

// The clamp exists so locgen's single-pulse scheduler can never be handed overlapping pulses.
// It is a safety net, not part of the model — so it must NOT feed back into the state.
static void test_refractory_clamp_does_not_bend_the_rhythm() {
  LocRhythm r;
  loc_rhythm_init(&r, 7u, 1.0f, 1.0f);
  // A tempo far past any real eel, so the table floor lands under the refractory.
  loc_rhythm_set_knobs(&r, 400.0f, 1.0f);
  uint32_t min_seen = 0xFFFFFFFFu;
  bool below_clamp = false;
  uint32_t elapsed = 250u;
  for (int i = 0; i < 4000; i++) {
    uint32_t samp = loc_rhythm_next_ipi_samp(&r, elapsed, 50000u, 250u);
    CHECK(samp >= 250u, "an interval below the refractory must clamp up to it");
    if (samp < min_seen) min_seen = samp;
    // pending_dt keeps the model's own UNCLAMPED interval, so it must be seen to sit below
    // the clamp; if clamping were fed back, the state would drift with it.
    if (r.pending_dt * 50000.0f < 250.0f) below_clamp = true;
    elapsed = samp;
  }
  CHECK(min_seen == 250u, "the clamp must actually engage at an absurd tempo");
  CHECK(below_clamp, "the clamp must not feed back into the model's own interval");

  // ... and at a sane tempo it must never engage at all.
  loc_rhythm_init(&r, 8u, 1.0f, 1.0f);
  uint32_t lo = 0xFFFFFFFFu;
  elapsed = 0u;
  for (int i = 0; i < 20000; i++) {
    elapsed = loc_rhythm_next_ipi_samp(&r, elapsed, 50000u, 250u);
    if (elapsed < lo) lo = elapsed;
  }
  CHECK(lo > 1000u, "at a real eel's tempo the refractory clamp must never engage");
}

// Bad knob values must bound the output rather than stop the train. A zero or negative rate
// would divide the interval by zero — an infinite silence with no fault raised anywhere.
static void test_knobs_are_bounded() {
  LocRhythm r;
  loc_rhythm_init(&r, 3u, 1.0f, 1.0f);

  loc_rhythm_set_knobs(&r, 0.0f, 1.0f);
  CHECK(r.tempo >= LOC_TEMPO_MIN, "a zero rate must floor the tempo, not divide by zero");
  CHECK(std::isfinite(loc_rhythm_next_s(&r, 0.3f)),
        "a floored tempo must still give a finite interval");

  loc_rhythm_set_knobs(&r, 1.0f, -1.0f);
  CHECK(r.s == 0.0f, "negative randomness clamps to the metronome");
  loc_rhythm_set_knobs(&r, 1.0f, 99.0f);
  CHECK(r.s == LOC_KNOB_MAX, "randomness clamps to the top of the shipped table");

  // The table is clamped at both ends, so no score can ever produce an out-of-range interval.
  for (float z = -40.0f; z <= 40.0f; z += 0.25f) {
    float s = loc_rhythm_interval_for_score(z);
    CHECK(s >= LOC_IPI_MIN_S * 0.999f && s <= LOC_IPI_MAX_S * 1.001f,
          "interval_for_score must stay inside the table's range");
  }
  CHECK(fabsf(loc_rhythm_interval_for_score(LOC_Z_HI) - LOC_IPI_MAX_S) < 1e-3f * LOC_IPI_MAX_S,
        "the top of the table must be reachable exactly");
  CHECK(fabsf(loc_rhythm_interval_for_score(LOC_Z_LO) - LOC_IPI_MIN_S) < 1e-4f,
        "the bottom of the table must be reachable exactly");
}

// ===== what the model is FOR ===========================================================
//
// Through the device's own PRNG, not numpy's — so this also exercises the Box-Muller pair
// cache and the two-scale mixture, which the golden bypasses entirely.
static void test_it_is_not_a_renewal_process() {
  const int N = 60000;
  LocRhythm r;
  loc_rhythm_init(&r, 4242u, 1.0f, 1.0f);
  std::vector<double> ipi(N), lg(N);
  float dt = r.pending_dt;
  for (int i = 0; i < N; i++) { ipi[i] = run_free(&r, &dt); lg[i] = log(ipi[i]); }

  double mean = 0.0;
  for (double v : lg) mean += v;
  mean /= N;
  double var = 0.0;
  for (double v : lg) var += (v - mean) * (v - mean);
  var /= N;

  // THE POINT. A renewal process — the lognormal draw this replaced — is flat at zero at
  // every lag. Real recordings give 0.55 / 0.36 / 0.21 at lags 1 / 5 / 20.
  const int lags[3] = { 1, 5, 20 };
  const double floor_acf[3] = { 0.40, 0.25, 0.10 };
  for (int k = 0; k < 3; k++) {
    double c = 0.0;
    for (int i = 0; i + lags[k] < N; i++) c += (lg[i] - mean) * (lg[i + lags[k]] - mean);
    c /= (double)(N - lags[k]) * var;
    if (c < floor_acf[k]) {
      printf("FAIL: log-interval autocorrelation at lag %d is %.3f, below %.2f — the state "
             "has stopped wandering and this is a renewal process again\n",
             lags[k], c, floor_acf[k]);
      g_fail++;
    }
  }

  std::vector<double> sorted = ipi;
  std::sort(sorted.begin(), sorted.end());
  double median = sorted[N / 2];
  CHECK(median > 0.25 && median < 0.40, "median interval must sit near the measured 317 ms");

  // The noise is peaked, not Gaussian: a Gaussian of the same variance overshoots CV2 to
  // ~0.60 where the measurement is 0.38. This is what the two-scale mixture buys.
  std::vector<double> cv2;
  cv2.reserve(N - 1);
  for (int i = 1; i < N; i++) cv2.push_back(2.0 * fabs(ipi[i] - ipi[i - 1]) / (ipi[i] + ipi[i - 1]));
  std::sort(cv2.begin(), cv2.end());
  double m_cv2 = cv2[cv2.size() / 2];
  CHECK(m_cv2 > 0.30 && m_cv2 < 0.55, "median CV2 must stay near the measured 0.42");

  // Long silences are real and must survive: 1.5 % of intervals exceed 5 s.
  int long_ones = 0;
  for (double v : ipi) if (v > 5.0) long_ones++;
  CHECK(long_ones > N / 400, "the heavy tail has been clamped out — long silences are measured");
}

// Randomness 0 must be an exact metronome: the one setting an operator can verify by eye.
static void test_metronome() {
  LocRhythm r;
  loc_rhythm_init(&r, 55u, 1.0f, 0.0f);
  float dt = r.pending_dt;
  float first = run_free(&r, &dt);
  for (int i = 0; i < 500; i++)
    CHECK(run_free(&r, &dt) == first, "randomness 0 must be exactly periodic");
  // ... and the rate knob must place it, so the CH3 Hz scale means what it says.
  loc_rhythm_init(&r, 55u, loc_rhythm_rate_for_hz(5.0f), 0.0f);
  dt = r.pending_dt;
  float hz = 1.0f / run_free(&r, &dt);
  CHECK(hz > 4.5f && hz < 5.5f, "a metronome at 5 Hz must tick at about 5 Hz");
}

// Rate is a pure time dilation: it divides the intervals AND stretches the time constants, so
// the pulse-indexed texture does not move with it. If someone drops the tempo out of the state
// update, the wander washes out at slow settings — back to a renewal process where it matters.
static void test_rate_is_a_pure_dilation() {
  const int N = 40000;
  double med[2], acf[2];
  const float rates[2] = { 0.5f, 4.0f };
  for (int k = 0; k < 2; k++) {
    LocRhythm r;
    loc_rhythm_init(&r, 909u, rates[k], 1.0f);
    std::vector<double> ipi(N), lg(N);
    float dt = r.pending_dt;
    for (int i = 0; i < N; i++) { ipi[i] = run_free(&r, &dt); lg[i] = log(ipi[i]); }
    std::vector<double> s = ipi;
    std::sort(s.begin(), s.end());
    med[k] = s[N / 2];
    double mean = 0.0, var = 0.0, c = 0.0;
    for (double v : lg) mean += v;
    mean /= N;
    for (double v : lg) var += (v - mean) * (v - mean);
    var /= N;
    for (int i = 0; i + 1 < N; i++) c += (lg[i] - mean) * (lg[i + 1] - mean);
    acf[k] = c / ((double)(N - 1) * var);
  }
  double ratio = (med[0] / med[1]) / (double)(rates[1] / rates[0]);
  CHECK(fabs(ratio - 1.0) < 0.10, "an 8x rate change must scale the intervals by 8x");
  CHECK(fabs(acf[0] - acf[1]) < 0.10,
        "the autocorrelation must not move with the rate knob — tau has to stretch with it");
}

// Time spent outside the rhythm must age the state. Without it the fish comes out of a long
// volley at exactly the tempo it went in at, which is the one thing a wandering state must not
// do — and it is why the online call takes the ELAPSED time rather than accumulating on top of
// an interval that may never have been realised.
static void test_elapsed_time_ages_the_state() {
  LocRhythm a;
  loc_rhythm_init(&a, 21u, 1.0f, 1.0f);
  LocRhythm b = a;

  const float n[LOC_N_COMPONENTS + 1] = { 0.0f, 0.0f, 0.0f, 0.0f };
  // Same state, same noise, different elapsed time: a short interval versus five minutes
  // spent on a volley and an idle throttle.
  a.pending_dt = 0.3f;
  b.pending_dt = 300.0f;
  loc_rhythm_step(&a, n);
  loc_rhythm_step(&b, n);
  CHECK(fabsf(b.x[0]) < fabsf(a.x[0]), "a long pause must relax the fast component further");
  CHECK(fabsf(b.x[1]) < fabsf(a.x[1]), "a long pause must relax the medium component further");

  // The elapsed time is ASSIGNED, not accumulated: a preempted interval that was never
  // realised must not leave time booked behind it.
  LocRhythm c;
  loc_rhythm_init(&c, 22u, 1.0f, 1.0f);
  c.pending_dt = 99.0f;                       // as if a long interval had been scheduled
  loc_rhythm_next_s(&c, 0.05f);               // ... but a trial preempted it after 50 ms
  CHECK(c.pending_dt < 90.0f, "elapsed time must replace the pending interval, not add to it");

  // A negative elapsed time must read as zero rather than rewinding the clock.
  LocRhythm d;
  loc_rhythm_init(&d, 23u, 1.0f, 1.0f);
  LocRhythm e = d;
  loc_rhythm_next_s(&d, -5.0f);
  loc_rhythm_next_s(&e, 0.0f);
  CHECK(d.x[0] == e.x[0] && d.x[1] == e.x[1], "a negative elapsed time must behave as zero");
}

int main(int argc, char** argv) {
  const char* golden = (argc > 1) ? argv[1] : "tests/data/loc_rhythm_golden.csv";
  test_golden(golden);
  test_cold_start();
  test_init_burns_in_and_seeds();
  test_refractory_clamp_does_not_bend_the_rhythm();
  test_knobs_are_bounded();
  test_it_is_not_a_renewal_process();
  test_metronome();
  test_rate_is_a_pure_dilation();
  test_elapsed_time_ages_the_state();
  if (g_fail) { printf("%d FAILURES\n", g_fail); return 1; }
  printf("OK\n");
  return 0;
}
